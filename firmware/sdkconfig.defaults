## firmware/sdkconfig.defaults
```kconfig
# ESP32-S3 General Configuration
CONFIG_IDF_TARGET="esp32s3"

# Compiler Optimization for Performance (Highly recommended for AI)
CONFIG_COMPILER_OPTIMIZATION_PERF=y

# PSRAM Configuration
# Most AI models require PSRAM. Enable this if your module has PSRAM.
CONFIG_SPIRAM=y
# Note: If your module uses Quad PSRAM, change OCT to QUAD below, or use menuconfig.
# CONFIG_SPIRAM_MODE_OCT=y

# Face Detection Model Configuration
# This ensures the model is compiled into the firmware
CONFIG_FLASH_HUMAN_FACE_DETECT_MSRMNP_S8_V1=y

# Common performance settings
CONFIG_ESP_DEFAULT_CPU_FREQ_MHZ_240=y
CONFIG_FREERTOS_HZ=1000
CONFIG_MONITOR_BAUD=921600
CONFIG_ESP_CONSOLE_UART_BAUDRATE=921600
CONFIG_CONSOLE_UART_BAUDRATE=921600

# FreeRTOS settings for esp-who compatibility
CONFIG_FREERTOS_VTASKLIST_INCLUDE_COREID=y
CONFIG_FREERTOS_GENERATE_RUN_TIME_STATS=y
CONFIG_PARTITION_TABLE_CUSTOM=y
CONFIG_PARTITION_TABLE_CUSTOM_FILENAME="partitions.csv"
CONFIG_ESPTOOLPY_FLASHSIZE_16MB=y
CONFIG_SPIRAM=y
CONFIG_SPIRAM_MODE_OCT=y
CONFIG_SPIRAM_TYPE_AUTO=y
CONFIG_SPIRAM_SIZE=8388608
CONFIG_FREERTOS_RUN_TIME_COUNTER_TYPE_U64=y
```
